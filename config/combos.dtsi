/ {
  combos {
    compatible = "zmk,combos";

    combo_esc {
      timeout-ms = <50>;
      bindings = <&kp ESC>;
      key-positions = <13 14>;  // Q + W (índices no layout acima)
      layers = <0>;
    };
  };
};
